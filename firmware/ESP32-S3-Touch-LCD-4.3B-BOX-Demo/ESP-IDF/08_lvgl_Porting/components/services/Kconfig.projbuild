## firmware/ESP32-S3-Touch-LCD-4.3B-BOX-Demo/ESP-IDF/08_lvgl_Porting/components/services/Kconfig.projbuild
```kconfig
# Chỉ tuỳ chọn KHÔNG bí mật. device_id, secret, WiFi, Local AP, danh sách node nằm trong NVS (README).
menu "Gateway S3: services"

    config GW_MQTT_URI_DEFAULT
        string "MQTT Broker 2 mặc định (NVS cloud/mqtt_uri ghi đè)"
        default "mqtts://192.168.1.100:8883"
        help
            Host phải nằm trong SAN của chứng chỉ broker (infra/pki/gen_mqtt_certs.sh, docs/guides/MQTT_TLS.md).

    config GW_API_URL_DEFAULT
        string "Địa chỉ Backend mặc định (NVS cloud/api_url ghi đè)"
        default "https://192.168.1.100"
        help
            Dùng cho POST /api/device/data (đường dự phòng khi MQTT mất kết nối) và gửi ảnh camera.

    config GW_SNTP_SERVER
        string "Máy chủ NTP"
        default "pool.ntp.org"

    config GW_LOCAL_AP_CHANNEL
        int "Kênh Local AP khi chưa nối router"
        range 1 13
        default 1
        help
            Khi đã nối router, Local AP và ESP-NOW tự chuyển sang kênh của router (1 radio dùng chung).

    config GW_LOCAL_AP_MAX_CONN
        int "Số camera tối đa trên Local AP"
        range 1 4
        default 2

    config GW_HEARTBEAT_INTERVAL_S
        int "Chu kỳ heartbeat Gateway → Server (giây)"
        range 10 300
        default 30

    config GW_NODE_ACK_TIMEOUT_MS
        int "Thời gian chờ CMD_ACK của node (ms)"
        range 500 4500
        default 3000
        help
            IOT_NODE_NETWORK §6.3: node im lặng 3 giây thì Gateway trả ack error. Backend chờ ack 5 giây.

    config GW_NODE_OFFLINE_S
        int "Coi node mất kết nối sau bao nhiêu giây không thấy gói"
        range 30 600
        default 90

    config GW_MOTION_SNAPSHOT_WAIT_S
        int "Chờ ảnh sau sự kiện chuyển động (giây)"
        range 1 30
        default 5
        help
            Hết thời gian mà camera chưa gửi ảnh thì publish camera/event không kèm snapshot_id.

    choice GW_CAMERA_LIVE_FRAMESIZE
        prompt "Độ phân giải luồng camera trên màn hình"
        default GW_CAMERA_LIVE_FS_VGA
        help
            IOT_NODE_NETWORK §5.4. ESP32-S3 không có bộ giải mã JPEG phần cứng: Gateway giải nén bằng TJpgDec
            trong ROM, nên số khung/giây phụ thuộc chủ yếu vào độ phân giải.

        config GW_CAMERA_LIVE_FS_VGA
            bool "VGA 640x480 (nét, ít khung/giây hơn)"
        config GW_CAMERA_LIVE_FS_QVGA
            bool "QVGA 320x240, phóng lên khung 448x336 (mượt hơn, kém nét)"
    endchoice

    config GW_CAMERA_LIVE_QUALITY
        int "Chất lượng JPEG của luồng (10-30, nhỏ hơn = đẹp hơn, khung nặng hơn)"
        range 10 30
        default 12

    choice GW_UI_START_PAGE
        prompt "Trang hiện khi khởi động"
        default GW_UI_START_PAGE_CAMERA
        help
            Màn hình có thanh nav 3 mục (Camera, Phòng khách, Thiết bị). Luồng camera chỉ chạy khi đang ở trang
            Camera (IOT_NODE_NETWORK §5.4: chỉ kéo luồng khi có người xem).

        config GW_UI_START_PAGE_CAMERA
            bool "Camera (xem trực tiếp)"
        config GW_UI_START_PAGE_ROOM
            bool "Phòng khách"
        config GW_UI_START_PAGE_DEVICES
            bool "Danh sách thiết bị"
    endchoice

    config GW_CAMERA_LIVE_ON_MOTION_S
        int "Chuyển sang trang Camera khi có chuyển động, quay lại trang cũ sau (giây, 0 = không chuyển)"
        range 0 300
        default 30
        help
            Camera cửa báo EVENT motion qua ESP-NOW → màn hình tự chuyển sang trang Camera (bật luồng trực tiếp).
            Còn chuyển động thì gia hạn; hết thời gian mà không ai chạm màn hình thì về trang đang xem trước đó.
            Chạm vào nav thì huỷ việc tự quay lại.

    config GW_ESPNOW_ALLOW_UNENCRYPTED
        bool "[DEV] Cho peer ESP-NOW không mã hoá khi NVS thiếu LMK"
        default n
        help
            Chỉ dùng khi node/camera cũng bật tuỳ chọn [DEV] tương ứng. Bản demo/production phải tắt.

    config GW_DEV_ALLOW_PLAINTEXT
        bool "[DEV] Cho kết nối Server không TLS (mqtt://, http://)"
        default n
        help
            Hạ tầng hiện tại: Broker 2 chỉ nhận TLS (8883) nhưng nginx chỉ có cổng 80 (http). Bật để dùng đường
            dự phòng POST http://.../api/device/data khi dev. Không bao giờ tắt kiểm chứng chứng chỉ khi dùng TLS.

endmenu
```

## firmware/ESP32-S3-Touch-LCD-4.3B-BOX-Demo/ESP-IDF/08_lvgl_Porting/components/ui/Kconfig.projbuild
```kconfig
menu "Gateway S3: ui"

    config GW_UI_JPEG_TJPGD
        bool "[Dự phòng] Giải nén JPEG bằng TJpgDec trong ROM thay vì esp_new_jpeg"
        default n
        help
            Mặc định hình camera trên LCD được giải nén bằng espressif/esp_new_jpeg (nhanh hơn nhiều, có tối ưu cho
            ESP32-S3). Bật tuỳ chọn này nếu thư viện đó có vấn đề trên phần cứng: quay về TJpgDec trong ROM (VGA ≈ 3,3
            khung/giây). Lưu ý: idf_component.yml vẫn khai báo espressif/esp_new_jpeg (component manager không điều
            kiện theo Kconfig được) nên thư viện vẫn phải có sẵn trong components/ (hoặc tải được) khi dựng; tuỳ
            chọn này chỉ bỏ nó khỏi PRIV_REQUIRES của component ui và đổi bộ giải nén.

endmenu
```

## firmware/esp32_cam/components/drivers/Kconfig.projbuild
```kconfig
# Chỉ tuỳ chọn KHÔNG bí mật.
menu "ESP32-CAM: drivers"

    config CAM_SNAPSHOT_JPEG_QUALITY
        int "Chất lượng JPEG ảnh chụp (0-63, nhỏ hơn = đẹp hơn)"
        range 4 63
        default 12

    config CAM_PIR_GPIO
        int "GPIO cảm biến chuyển động PIR"
        range 0 39
        default 13
        help
            HC-SR501 nối GPIO13 (IOT_NODE_NETWORK Q2). Không dùng GPIO12 (strapping điện áp flash)
            hay GPIO16/17 (PSRAM).

    config CAM_PIR_COOLDOWN_S
        int "Khoảng cách tối thiểu giữa 2 sự kiện chuyển động (giây)"
        range 1 600
        default 10

    config CAM_PIR_WARMUP_S
        int "Bỏ qua PIR sau khi bật nguồn (giây)"
        range 0 120
        default 30
        help
            HC-SR501 báo nhầm trong khoảng 30-60 giây đầu sau khi cấp nguồn.

    config CAM_LED_BLINK
        bool "Nháy đèn flash theo chu kỳ"
        default y
        help
            Đèn flash LED trắng (GPIO4 trên AI-Thinker) sáng ngắn rồi tắt, lặp lại theo chu kỳ — báo board đang chạy.
            Đèn ở cạnh ống kính: lúc sáng thì khung hình sáng hơn.

    config CAM_LED_GPIO
        int "GPIO đèn flash"
        depends on CAM_LED_BLINK
        range 0 33
        default 4
        help
            AI-Thinker: GPIO4 (dùng chung DATA1 của thẻ SD — dự án không dùng thẻ SD ở chế độ 4-bit).

    config CAM_LED_BLINK_PERIOD_MS
        int "Chu kỳ nháy (ms)"
        depends on CAM_LED_BLINK
        range 200 10000
        default 1000

    config CAM_LED_BLINK_ON_MS
        int "Thời gian sáng mỗi lần nháy (ms, nhỏ hơn chu kỳ)"
        depends on CAM_LED_BLINK
        range 10 9990
        default 100

    config CAM_LED_BRIGHTNESS_PCT
        int "Độ sáng đèn khi nháy (%)"
        depends on CAM_LED_BLINK
        range 1 100
        default 20
        help
            PWM 5 kHz. Đèn flash rất sáng và hút dòng lớn: 100 % cùng lúc WiFi phát dễ gây brownout khi nguồn 5 V yếu.

endmenu
```

## firmware/esp32_cam/components/services/Kconfig.projbuild
```kconfig
# Chỉ tuỳ chọn KHÔNG bí mật. SSID, mật khẩu Local AP, device_id, secret, LMK nằm trong NVS (README).
menu "ESP32-CAM: services"

    config CAM_HEARTBEAT_INTERVAL_S
        int "Chu kỳ heartbeat ESP-NOW (giây)"
        range 5 300
        default 30

    config CAM_STREAM_MAX_FPS
        int "Giới hạn số khung/giây của luồng MJPEG"
        range 1 30
        default 20

    config CAM_GATEWAY_HTTP_PORT
        int "Cổng HTTP của Gateway trên Local AP"
        range 1 65535
        default 80

    config CAM_UPLOAD_TIMEOUT_MS
        int "Thời gian chờ gửi ảnh tới Gateway (ms)"
        range 500 10000
        default 2500
        help
            Gateway chờ CMD_ACK tối đa 3 giây, nên để dưới 3000 ms.

    config CAM_ESPNOW_ALLOW_UNENCRYPTED
        bool "[DEV] Cho ESP-NOW không mã hoá khi NVS chưa có session_key"
        default n
        help
            Chỉ dùng khi Gateway chưa làm ghép nối ECDH. Bản demo/production phải tắt.

    config CAM_DEV_SNTP_SERVER
        string "[DEV] Máy chủ SNTP (để trống = tắt)"
        default ""
        help
            Production: Local AP không có Internet, giờ lấy từ Gateway qua ESP-NOW TIME_SYNC.
            Khi dev nối camera vào AP có Internet (VD hotspot điện thoại) thì điền "pool.ntp.org"
            để có giờ mà ký/kiểm HMAC.

endmenu
```

## firmware/esp32_s3_firmware_node/components/application/Kconfig.projbuild
```kconfig
# Chỉ tuỳ chọn KHÔNG bí mật. device_id, secret, MAC Gateway, LMK nằm trong NVS (README, mục Ghép nối Gateway).
menu "Node S3: ứng dụng"

    config NODE_APP_TELEMETRY_INTERVAL_S
        int "Chu kỳ gửi số đo + trạng thái tải về Gateway (giây)"
        range 5 3600
        default 10
        help
            Màn hình Node vẫn cập nhật 2 giây/lần; đây chỉ là chu kỳ gửi ESP-NOW TELEMETRY (Gateway chuyển tiếp lên
            Server, mỗi gói là 1 dòng sensor_data): nhiệt độ, độ ẩm và trạng thái đèn, quạt, rèm, điều hòa. Tải đổi
            trạng thái thì gửi ngay, không chờ chu kỳ. Server tính đèn/quạt/rèm/điều hòa online theo gói này, nên đừng
            đặt quá 60 giây. Gói đầu tiên gửi ngay khi đã nối Gateway và có giờ.

    config NODE_APP_RESTORE_SWITCHES
        bool "Khôi phục trạng thái đèn, quạt khi có điện lại"
        default y
        help
            Bật: mỗi lần đèn/quạt đổi trạng thái thì lưu NVS, khởi động lại thì đóng relay theo trạng thái đã lưu (như
            công tắc thông minh). Tắt: luôn TẮT khi khởi động. Rèm luôn nhớ vị trí và không tự chạy khi có điện lại.

    config NODE_AUDIO_BEEP_ON_ACTION
        bool "Bíp khi bật/tắt đèn, quạt, rèm"
        depends on NODE_AUDIO_ENABLE
        default y

    config NODE_AUDIO_MIC_SELFTEST
        bool "[Thử mic] In mức âm (dBFS) ra log mỗi 5 giây"
        depends on NODE_AUDIO_ENABLE
        default n
        help
            Chỉ để kiểm mic sau khi lắp: task âm thanh đọc mic liên tục. Tắt khi một tính năng khác cần đọc mic.

endmenu
```

## firmware/esp32_s3_firmware_node/components/services/Kconfig.projbuild
```kconfig
# Chỉ tuỳ chọn KHÔNG bí mật. device_id, secret, MAC Gateway, LMK nằm trong NVS (README).
menu "Node S3: services"

    config NODE_HEARTBEAT_INTERVAL_S
        int "Chu kỳ heartbeat ESP-NOW (giây)"
        range 5 300
        default 30
        help
            IOT_NODE_NETWORK §4.1: 30 giây/lần.

    config NODE_PING_INTERVAL_S
        int "Chu kỳ gửi PING khi chưa có giờ từ Gateway (giây)"
        range 1 60
        default 5

    config NODE_LINK_MAX_FAILS
        int "Số lần gửi thất bại liên tiếp trước khi dò lại kênh"
        range 1 20
        default 3
        help
            IOT_NODE_NETWORK §5.1: mất ack liên tiếp 3 lần thì quét lại kênh 1-13.

    config NODE_CMD_REQUIRE_TS
        bool "Bắt buộc lệnh CMD có trường ts (chống phát lại)"
        default n
        help
            Hợp đồng hiện tại (API_DESIGN §11) chưa có ts trong CMD. Khi Gateway đã gửi {command_id, action,
            ts} thì bật để node từ chối lệnh cũ/không có ts. Khi tắt: lệnh có ts vẫn được kiểm cửa sổ.

    config NODE_CMD_TS_WINDOW_S
        int "Cửa sổ chấp nhận ts của lệnh (giây)"
        range 5 300
        default 30

    config NODE_ESPNOW_ALLOW_UNENCRYPTED
        bool "[DEV] Cho ESP-NOW không mã hoá khi NVS chưa có session_key"
        default n
        help
            Chỉ dùng khi Gateway chưa làm ghép nối ECDH. Bản demo/production phải tắt.

endmenu
```
